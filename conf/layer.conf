## conf/layer.conf
```bitbake
# We have a conf and classes directory, add to BBPATH
BBPATH .= ":${LAYERDIR}"

# We have recipes-* directories, add to BBFILES
BBFILES += "${LAYERDIR}/recipes-*/*/*.bb \
            ${LAYERDIR}/recipes-*/*/*.bbappend"

BBFILE_COLLECTIONS += "zaltys-platform"
BBFILE_PATTERN_zaltys-platform = "^${LAYERDIR}/"
BBFILE_PRIORITY_zaltys-platform = "6"
LAYERVERSION_zaltys-platform = "1"
```
